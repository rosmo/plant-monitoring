## main/Kconfig.projbuild
```kconfig
menu "Plant Monitoring Configuration"

    config ESP_WIFI_SSID
        string "WiFi SSID"
        default "myssid"
        help
            SSID (network name) for the example to connect to.

    config ESP_WIFI_PASSWORD
        string "WiFi Password"
        default "mypassword"
        help
            WiFi password (WPA or WPA2) for the example to use.

    choice ESP_WIFI_SAE_MODE
        prompt "WPA3 SAE mode selection"
        default ESP_WPA3_SAE_PWE_BOTH
        help
            Select mode for SAE as Hunt and Peck, H2E or both.
        config ESP_WPA3_SAE_PWE_HUNT_AND_PECK
            bool "HUNT AND PECK"
        config ESP_WPA3_SAE_PWE_HASH_TO_ELEMENT
            bool "H2E"
        config ESP_WPA3_SAE_PWE_BOTH
            bool "BOTH"
    endchoice

    config ESP_WIFI_PW_ID
        string "PASSWORD IDENTIFIER"
        depends on  ESP_WPA3_SAE_PWE_HASH_TO_ELEMENT|| ESP_WPA3_SAE_PWE_BOTH
        default ""
        help
            password identifier for SAE H2E

    config ESP_MAXIMUM_RETRY
        int "Maximum retry"
        default 5
        help
            Set the Maximum retry to avoid station reconnecting to the AP unlimited when the AP is really inexistent.

    choice ESP_WIFI_SCAN_AUTH_MODE_THRESHOLD
        prompt "WiFi Scan auth mode threshold"
        default ESP_WIFI_AUTH_WPA2_PSK
        help
            The weakest authmode to accept in the scan mode.
            This value defaults to ESP_WIFI_AUTH_WPA2_PSK incase password is present and ESP_WIFI_AUTH_OPEN is used.
            Please select ESP_WIFI_AUTH_WEP/ESP_WIFI_AUTH_WPA_PSK incase AP is operating in WEP/WPA mode.

        config ESP_WIFI_AUTH_OPEN
            bool "OPEN"
        config ESP_WIFI_AUTH_WEP
            bool "WEP"
        config ESP_WIFI_AUTH_WPA_PSK
            bool "WPA PSK"
        config ESP_WIFI_AUTH_WPA2_PSK
            bool "WPA2 PSK"
        config ESP_WIFI_AUTH_WPA_WPA2_PSK
            bool "WPA/WPA2 PSK"
        config ESP_WIFI_AUTH_WPA3_PSK
            bool "WPA3 PSK"
        config ESP_WIFI_AUTH_WPA2_WPA3_PSK
            bool "WPA2/WPA3 PSK"
        config ESP_WIFI_AUTH_WAPI_PSK
            bool "WAPI PSK"
    endchoice

    # Configuration URL, fetched on startup. Format is one line per station,
    # MAC address in hex (lowercase) and station name, separated by space, eg:
    # 00:00:00:00:00:00 room1
    # 12:34:56:ab:cd:ef room2
    #
    # PROTIP: In Home Assistant, you can create a www/ directory under your config
    # folder and files there are accessible using http://homeassistant/local/file.txt
    config ESP_CONFIG_URL
        string "Configuration URL"
        default "http://homeassistant.localdomain/local/plants.txt"
        help
            Configuration URL.

    # Find your TZ string from: https://github.com/nayarsystems/posix_tz_db/blob/master/zones.csv
    config ESP_NTP_TZ
        string "NTP timezone"
        default "CET-1CEST,M3.5.0,M10.5.0/3"
        help
            Timezone.

    config ESP_NTP_SERVER
        string "NTP server host"
        default "pool.ntp.org"
        help
            NTP server hostname.

    config ESP_INFLUXDB_HOST
        string "InfluxDB host"
        default "influxdb.localdomain"
        help
            InfluxDB hostname.

    config ESP_INFLUXDB_PORT
        int "InfluxDB port"
        default "8086"
        help
            InfluxDB hostname.

    config ESP_INFLUXDB_PATH
        string "InfluxDB path"
        default "/api/v2/write"
        help
            InfluxDB path.

    choice ESP_INFLUXDB_VERSION
        prompt "InfluxDB version"
        default ESP_INFLUXDB_VERSION_V1
        help
            InfluxDB version (v1 or v2, only v1.8+ supported for now.)
        config ESP_INFLUXDB_VERSION_V1
            bool "1.8+"
        config ESP_INFLUXDB_VERSION_V2
            bool "2.x"
    endchoice

    config ESP_INFLUXDB_USERNAME
        string "InfluxDB username"
        default "username"
        help
            InfluxDB username.

    config ESP_INFLUXDB_PASSWORD
        string "InfluxDB password"
        default "password"
        help
            InfluxDB password.

    config ESP_INFLUXDB_ORG
        string "InfluxDB organization ID (v2)"
        default "1a2b3c4d5e6f7g"
        help
            InfluxDB organization ID.

    config ESP_INFLUXDB_BUCKET
        string "InfluxDB bucket (v2)"
        default "plants"
        help
            InfluxDB organization ID.

endmenu
```

## sdkconfig.defaults
```kconfig
CONFIG_MAIN_TASK_STACK_SIZE=16384
CONFIG_ESP_SYSTEM_EVENT_TASK_STACK_SIZE=8096
CONFIG_PM_ENABLE=1
CONFIG_PM_DFS_INIT_AUTO=y
CONFIG_PM_POWER_DOWN_CPU_IN_LIGHT_SLEEP=y
```
